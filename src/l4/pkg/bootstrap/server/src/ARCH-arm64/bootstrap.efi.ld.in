/* SPDX-License-Identifier: GPL-2.0-only or License-Ref-kk-custom */
/*
 * Copyright (C) 2014-2020 Kernkonzept GmbH.
 * Author(s): Jan Klötzke <jan.kloetzke@kernkonzept.com>
 */

#include "ldscript.inc"

OUTPUT_FORMAT("elf64-littleaarch64", "elf64-bigaarch64",
              "elf64-littleaarch64")
OUTPUT_ARCH(aarch64)
ENTRY(_start)

SECTIONS
{
  /*
   * The text section must start at address 0 because it holds the PE/COFF
   * header that must be at the start of the file. In the same vein we also
   * define _start here because there is no real entry point as far as the ELF
   * image is concerned.
   */
  .text 0x0 : {
    _text = .;
    _start = .;
    *(.text.head)
    *(.text)
    *(.text.*)
    *(.gnu.linkonce.t.*)
    *(.srodata)
    *(.rodata*)
    . = ALIGN(16);
  }

  _etext = .;
  PROVIDE (etext = .);
  _text_size = . - _text;

  .dynamic : { *(.dynamic) }
  .data : ALIGN(4096)
  {
    _data = .;
    *(.sdata)
    *(.data)
    *(.data1)
    *(.data.*)
    *(.got.plt)
    *(.got)

    CTORS
    PLATFORMS

    /*
     * The EFI loader doesn't seem to like a .bss section, so we stick it all
     * into .data:
     */
    . = ALIGN(16);
    _bss_start = .;
    *(.sbss)
    *(.scommon)
    *(.dynbss)
    *(.bss)
    *(COMMON)
    . = ALIGN(16);
    _bss_end = .;
  }
  _end = . ;
  PROVIDE (end = .);

  .data.m :
  {
    _module_data_start = .;
    *(.module_data)
    _module_data_end = .;
  }

  .rela.dyn : { *(.rela.dyn) }
  .rela.plt : { *(.rela.plt) }
  .rela.got : { *(.rela.got) }
  .rela.data : { *(.rela.data) *(.rela.data*) }
  . = ALIGN(512);
  _edata = .;
  _data_size = . - _data;

  . = ALIGN(4096);
  .dynsym : { *(.dynsym) }
  . = ALIGN(4096);
  .dynstr : { *(.dynstr) }
  . = ALIGN(4096);
  .note.gnu.build-id : { *(.note.gnu.build-id) }
  /DISCARD/ :
  {
    *(.rel.reloc)
    *(.eh_frame)
    *(.note.GNU-stack)
  }
  .comment 0 : { *(.comment) }
}

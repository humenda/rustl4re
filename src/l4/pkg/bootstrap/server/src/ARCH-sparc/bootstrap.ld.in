
#include "ldscript.inc"

ENTRY(_start)

PHDRS {
  common PT_LOAD;
  mods PT_LOAD;
}

SECTIONS
{
  . = LINKADDR;
  /* Merge .text, .rodata, and .data in one segment to save space */
  .text :
  {
	_stext = .;
    *(.init)
    *(.text .text.* .gnu.linkonce.t.*)
  } : common

  .note.gnu.build-id : { *(.note.gnu.build-id) }

  .data :
  {
    *(.rodata* .gnu.linkonce.r.*)
    . = ALIGN(8);
    *(.data)
    *(.data.*)

    CTORS
    PLATFORMS
  } : common

  _edata  =  .;
  PROVIDE (edata = .);
  . = ALIGN(4096);
  _bss_start = .;
  .bss :
  {
   *(.bss)
   *(COMMON)
   *(.bss_memmap)
  } : common
  _bss_end = .;
  _end = . ;
  PROVIDE (end = .);

/* Only move modules to modaddr if bootstrap is being loaded by an elf
 * loader, and we do not need to copy images around at runtime (e.g. with
 * compression) */
#if defined(PLACE_MODULES_AT_MODADDR)
  . = RAM_BASE + MODADDR;
#endif
  .data.m :
  {
    _module_data_start = .;
    *(.module_data)
    _module_data_end = .;
  } : mods

  /DISCARD/ : {
    *(.interp)
    *(.comment)
    *(.note)
    *(.eh_frame)
    *(.stab)
    *(.stabstr)
    *(.fini)
  }
}

/*
 * This file is subject to the terms and conditions of the GNU General Public
 * License 2.  See the file "COPYING-GPL-2" in the main directory of this
 * archive for more details.
 *
 * Copyright (C) 2014 Imagination Technologies Ltd.
 * Author: Sanjay Lal <sanjayl@kymasys.com>
 * Author: Yann Le Du <ledu@kymasys.com>
 */

#include "ldscript.inc"

#if CPU_ABI == 64
OUTPUT_FORMAT("elf64-tradlittlemips", "elf64-tradbigmips",
	      "elf64-tradlittlemips")
#else
OUTPUT_FORMAT("elf32-tradlittlemips", "elf32-tradbigmips",
	      "elf32-tradlittlemips")
#endif
/* OUTPUT_ARCH(mips) */
ENTRY(_start)

PHDRS {
  common PT_LOAD;
#ifndef SINGLE_SECTION
  mods PT_LOAD;
#endif
}

/* Some explanation for SINGLE_SECTION thing: For bootstrap we want to have
 * a single program header only because some boot-loaders require that.
 * Unfortunately it does not seem to be possible to have the following
 * order:
 *         text - data - bss - modules
 * because bss is smaller in the binary than unpacked and things get screwed
 * up. So what we do it the following:
 *         text - data_including_bss - modules
 * This way things seem to work and we only have one program header.
 */

SECTIONS
{
  /* Read-only sections, merged into text segment. The start address of
   * the text segment is : */
  . = LINKADDR;
  .text :
  {
    _stext = .;
    *(.text.init) 
    *(.init)
    *(.text .text.* .gnu.linkonce.t.*)
    *(.glue_7t) *(.glue_7)
    . = ALIGN(0x40);
    *(.rodata .rodata.* .gnu.linkonce.r.* .rodata1)
    *(.mips16.fn.*) *(.mips16.call.*)
  } : common

  _etext = .;
  PROVIDE (etext = .);

  /* ensure that data starts at a new L4 page */
  . = ALIGN(4096);
  .data :
  {
    *(.data .data.* .gnu.linkonce.d.*)
    *(.anno)

    CTORS
    PLATFORMS

    . = ALIGN(4);
    _module_info_start = .;
    KEEP(*(.module_info))
    _module_info_end   = .;

  _gp = ALIGN(16) + 0x7ff0;
  *(.got)
  /* We want the small data sections together, so single-instruction offsets
     can access them all, and initialized data all before uninitialized, so
     we can shorten the on-disk segment size.  */
  *(.sdata .sdata.* .gnu.linkonce.s.*)
#ifndef SINGLE_SECTION
  } : common
#endif

  . = ALIGN(4);
  _edata  =  .;
  PROVIDE (edata = .);

  _bss_start = .;
#ifndef SINGLE_SECTION
  .bss :
  {
#endif
   *(.dynbss)
   *(.bss .gnu.linkonce.b.*)
   *(COMMON)
  } : common
  _bss_end = .;
  _end = . ;
  PROVIDE (end = .);

/* Only move modules to modaddr if bootstrap is being loaded by an elf
 * loader, and we do not need to copy images around at runtime (e.g. with
 * compression) */
#if defined(PLACE_MODULES_AT_MODADDR) && !defined(SINGLE_SECTION)
  . = RAM_BASE + MODADDR;
#endif
  . = ALIGN(4096);
  .data.m :
  {
    . = ALIGN(4096);
    _module_data_start = .;
    *(EXCLUDE_FILE (*mod00.bin *mod01.bin *mod02.bin) .module_data)
    *(.module_data)
    _module_data_end = .;
#ifndef SINGLE_SECTION
  } : mods
#else
  } : common
#endif

  /* Moved here to ensure that these sections are located _after_ the text
   * section. In the other case we would get program sections with a virtual
   * address of 0 */
  .hash    : { *(.hash)    }
  .dynsym  : { *(.dynsym)  }
  .dynstr  : { *(.dynstr)  }
  .rel.dyn : { *(.rel.dyn) }

  /* drop the following sections since we do not need them for DROPS */
  /DISCARD/ : {
    *(.interp)
    *(.MIPS.abiflags)
    *(.eh_frame) *(.eh_frame_hdr) *(.eh_frame_entry .eh_frame_entry.*)
    *(.fini)
    *(.comment)
    *(.note)
    *(.stab)
    *(.fini)
    *(.reginfo)
  }
}

/*
 * (c) 2008-2009 Adam Lackorzynski <adam@os.inf.tu-dresden.de>,
 *               Alexander Warg <warg@os.inf.tu-dresden.de>,
 *               Frank Mehnert <fm3@os.inf.tu-dresden.de>
 *     economic rights: Technische Universität Dresden (Germany)
 *
 * This file is part of TUD:OS and distributed under the terms of the
 * GNU General Public License 2.
 * Please see the COPYING-GPL-2 file for details.
 */

#include "ldscript.inc"

OUTPUT_FORMAT("elf32-littlearm", "elf32-bigarm",
              "elf32-littlearm")
OUTPUT_ARCH(arm)
ENTRY(_start)

PHDRS {
  common PT_LOAD;
#ifndef SINGLE_SECTION
  mods PT_LOAD;
#endif
}

/* Some explanation for SINGLE_SECTION thing: For bootstrap we want to have
 * a single program header only because some boot-loaders require that.
 * Unfortunately it does not seem to be possible to have the following
 * order:
 *         text - data - bss - modules
 * because bss is smaller in the binary than unpacked and things get screwed
 * up. So what we do it the following:
 *         text - data_including_bss - modules
 * This way things seem to work and we only have one program header.
 */

SECTIONS
{
  /* Read-only sections, merged into text segment. The start address of
   * the text segment is : */
  . = LINKADDR;
  .text :
  {
    _stext = .;
    *(.text.init) 
    *(.init)
    *(.text .text.* .gnu.linkonce.t.*)
    *(.glue_7t) *(.glue_7)
    KEEP (*(.fini))
    LONG(0xc3)  /* terminate .fini */
    . = ALIGN(0x40);
    *(.rodata .rodata.* .gnu.linkonce.r.* .rodata1)
  } : common

  _etext = .;
  PROVIDE (etext = .);

  /* ensure that data starts at a new L4 page */
  . = ALIGN(4096);
  .data :
  {
    *(.data .data.* .gnu.linkonce.d.*)
    *(.anno)

    CTORS
    PLATFORMS

    . = ALIGN(4);
    _module_info_start = .;
    KEEP(*(.module_info))
    _module_info_end   = .;

#ifndef SINGLE_SECTION
  } : common

  /* exception frames for C++ */
  .eh_frame :
  {
#endif
    KEEP (*(.eh_frame))
    LONG(0) /* terminate .eh_frame */
#ifndef SINGLE_SECTION
  } : common
#endif

  . = ALIGN(4);
  _edata  =  .;
  PROVIDE (edata = .);

  _bss_start = .;
#ifndef SINGLE_SECTION
  .bss :
  {
#endif
   *(.dynbss)
   *(.bss .gnu.linkonce.b.*)
   *(COMMON)
  } : common
  _bss_end = .;
  _end = . ;
  PROVIDE (end = .);

/* Only move modules to modaddr if bootstrap is being loaded by an elf
 * loader, and we do not need to copy images around at runtime (e.g. with
 * compression) */
#if defined(PLACE_MODULES_AT_MODADDR) && !defined(SINGLE_SECTION)
  . = RAM_BASE + MODADDR;
#endif
  . = ALIGN(4096);
  .data.m :
  {
    . = ALIGN(4096);
    _module_data_start = .;
    *(EXCLUDE_FILE (*mod00.bin *mod01.bin *mod02.bin) .module_data)
    *(.module_data)
    _module_data_end = .;
#ifndef SINGLE_SECTION
  } : mods
#else
  } : common
#endif

  /* Moved here to ensure that these sections are located _after_ the text
   * section. In the other case we would get program sections with a virtual
   * address of 0 */
  .hash    : { *(.hash)    }
  .dynsym  : { *(.dynsym)  }
  .dynstr  : { *(.dynstr)  }
  .rel.dyn : { *(.rel.dyn) }

  /* drop the following sections since we do not need them for DROPS */
  /DISCARD/ : {
    *(.interp)
    *(.comment)
    *(.note)
    *(.stab)
    *(.fini)
    *(.ARM.exidx*)
  }
}

